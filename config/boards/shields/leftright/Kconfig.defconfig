## config/boards/shields/leftright/Kconfig.defconfig
```kconfig
if SHIELD_LEFTRIGHT_LEFT

config ZMK_KEYBOARD_NAME
    default "LR Keyboard"

config ZMK_SPLIT_ROLE_CENTRAL
    default y

endif

if SHIELD_LEFTRIGHT_LEFT || SHIELD_LEFTRIGHT_RIGHT

config ZMK_SPLIT
    default y

endif
```

## config/boards/shields/leftright/Kconfig.shield
```kconfig
# No whitespace after the comma or in your part name!
config SHIELD_LEFTRIGHT_LEFT
    def_bool $(shields_list_contains,leftright_left)

# No whitespace after the comma or in your part name!
config SHIELD_LEFTRIGHT_RIGHT
    def_bool $(shields_list_contains,leftright_right)
```
